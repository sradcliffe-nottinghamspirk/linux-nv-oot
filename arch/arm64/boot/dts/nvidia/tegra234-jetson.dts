/*
 * Copyright (c) 2022, NVIDIA CORPORATION & AFFILIATES.
 *
 * SPDX-License-Identifier: GPL-2.0
 */

/dts-v1/;
/plugin/;

/ {
	overlay-name = "Tegra234 Jetson Overlay";
	compatible = "nvidia,tegra234";
};
