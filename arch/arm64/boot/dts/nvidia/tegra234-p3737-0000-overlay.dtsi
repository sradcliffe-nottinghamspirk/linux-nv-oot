// SPDX-License-Identifier: GPL-2.0
// Copyright (c) 2022, NVIDIA CORPORATION & AFFILIATES.  All rights reserved.


/ {
	fragment-t234@0 {
		__overlay__ {
			ufshci@2500000 {
				status = "okay";
			};
		};
	};
};
