/*
 * Copyright (c) 2022, NVIDIA CORPORATION.  All rights reserved.
 *
 * This program is free software; you can redistribute it and/or modify it
 * under the terms and conditions of the GNU General Public License,
 * version 2, as published by the Free Software Foundation.
 *
 * This program is distributed in the hope it will be useful, but WITHOUT
 * ANY WARRANTY; without even the implied warranty of MERCHANTABILITY or
 * FITNESS FOR A PARTICULAR PURPOSE.  See the GNU General Public License for
 * more details.
 *
 * You should have received a copy of the GNU General Public License
 * along with this program.  If not, see <http://www.gnu.org/licenses/>.
 */

/*
 * Jetson Device-tree overlay for OP-TEE.
 */

/dts-v1/;
/plugin/;

/ {
	overlay-name = "OP-TEE overlay";
	compatible = "nvidia,tegra194", "nvidia,tegra234";

	fragment@0 {
		target-path = "/";
		board_config {
			sw-modules = "kernel";
		};
		__overlay__ {
			firmware {
				optee {
					compatible = "linaro,optee-tz";
					method = "smc";
					status = "disabled";
				};
			};
		};
	};
};
