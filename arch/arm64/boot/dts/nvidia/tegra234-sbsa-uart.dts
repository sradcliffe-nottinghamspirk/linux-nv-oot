/*
 * Copyright (c) 2022, NVIDIA CORPORATION.  All rights reserved.
 *
 * This program is free software; you can redistribute it and/or modify it
 * under the terms and conditions of the GNU General Public License,
 * version 2, as published by the Free Software Foundation.
 *
 * This program is distributed in the hope it will be useful, but WITHOUT
 * ANY WARRANTY; without even the implied warranty of MERCHANTABILITY or
 * FITNESS FOR A PARTICULAR PURPOSE.  See the GNU General Public License for
 * more details.
 *
 * You should have received a copy of the GNU General Public License
 * along with this program.  If not, see <http://www.gnu.org/licenses/>.
 */

/*
 * Tegra234 Device-tree overlay for SBSA UART
 */

/dts-v1/;
/plugin/;

#include <dt-bindings/interrupt-controller/arm-gic.h>

/ {
	overlay-name = "Tegra234 SBSA UART overlay";
	compatible = "nvidia,tegra234";

	fragment@0 {
		target-path = "/bus@0/";
		__overlay__ {
			serial@31d0000 {
				compatible = "arm,sbsa-uart";
				reg = <0x31d0000 0x10000>;
				interrupts = <GIC_SPI 285 IRQ_TYPE_LEVEL_HIGH>;
				current-speed = <115200>;
				status = "okay";
			};
		};
	};
};
