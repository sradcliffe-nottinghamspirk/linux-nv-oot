## Documentation/devicetree/bindings/hwmon/generic-pwm-tachometer.yaml
```yaml
# SPDX-License-Identifier: (GPL-2.0 OR BSD-2-Clause)
%YAML 1.2
---
$id: http://devicetree.org/schemas/hwmon/generic-pwm-tachometer.yaml#
$schema: http://devicetree.org/meta-schemas/core.yaml#

title: Generic PWM based tachometer HW monitor driver

maintainers:
  - Laxman Dewangan <ldewangan@nvidia.com>

description: |
  Generic PWM based tachometer driver which captures the PWM signal and reports
  the speed of the device which generates the PWM signal. This helps in monitor
  the speed of fan.

properties:
  compatible:
    enum:
      - generic-pwm-tachometer

  pwms:
    maxItems: 1
    description: |
      This property contains the phandle of the PWM controller which capture the
      PWM signal.

required:
  - compatible
  - pwms

additionalProperties: false

examples:
  - |
    tegra_tachometer: tachometer@39c0000 {
       reg = <0x39c0000 0x0>;
       #pwm-cells = <2>;
       /* Other properties of tachometer */
    };

    generic_pwm_tachometer {
       compatible = "generic-pwm-tachometer";
       pwms = <&tegra_tachometer 0 1000000>;
    };
...
```

## Documentation/devicetree/bindings/i2c/i2c-tegra-slave-byte.yaml
```yaml
# SPDX-License-Identifier: (GPL-2.0-only OR BSD-2-Clause)
%YAML 1.2
---
$id: http://devicetree.org/schemas/i2c/i2c-tegra-slave-byte.yaml#
$schema: http://devicetree.org/meta-schemas/core.yaml#

title: NVIDIA Tegra I2C slave Device Tree binding

maintainers:
  - Laxman Dewangan <ldewangan@nvidia.com>

allOf:
  - $ref: /schemas/i2c/i2c-controller.yaml#

properties:
  compatible:
    enum:
      - nvidia,tegra210-i2c-slave
      - nvidia,tegra-i2c-slave-byte

  reg:
    maxItems: 1
    description: |
       Base address and size of the physical address of I2C controller.

  interrupts:
    maxItems: 1

  clocks:
    maxItems: 2
    description: |
       Two entries, first one is root clock of the controller and second
       one is parent clock of the controller.

  clock-names:
     description: |
        Name of the clock source. The valid names are "div-clk" and "parent".

  resets:
    maxItems: 1
    description: |
       Specifies the reset line.

  reset-names:
    description: |
      Specifies the name of the reset line. Valid name is "i2c".


  clock-frequency:
    minimum: 500
    maximum: 4000000
    default: 100000
    description: frequency of the bus clock in Hz defaults to 100 kHz when not
      specified

  nvidia,hw-instance-id:
    $ref: /schemas/types.yaml#/definitions/uint32
    description: Instance ID of the controller.


required:
  - reg
  - compatible
  - clocks
  - clock-names
  - resets
  - reset-names

unevaluatedProperties: false

examples:
  - |
    #define TEGRA234_IRQ_I2C5                29
    #define TEGRA234_CLK_PLLP_OUT0           102U
    #define TEGRA234_CLK_I2C5                305U
    #define TEGRA234_RESET_I2C5              32U

    soc {
       #address-cells = <2>;
       #size-cells = <2>;

       pwr_i2c: i2c@31a0000 {
            #address-cells = <1>;
            #size-cells = <0>;
            compatible = "nvidia,tegra210-i2c-slave";
            reg = <0x0 0x31a0000 0x0 0x100>;
            nvidia,hw-instance-id = <0x4>;
            interrupts = <0 TEGRA234_IRQ_I2C5 0x04>;
            clock-frequency = <100000>;
            clocks = <&bpmp_clks TEGRA234_CLK_I2C5>,
                     <&bpmp_clks TEGRA234_CLK_PLLP_OUT0>;
            clock-names = "div-clk", "parent";
            resets = <&bpmp_resets TEGRA234_RESET_I2C5>;
            reset-names = "i2c";
        };
    };
...
```

## Documentation/devicetree/bindings/mfd/nvidia-vrs-pseq.yaml
```yaml
# SPDX-License-Identifier: (GPL-2.0-only OR BSD-2-Clause)
%YAML 1.2
---
$id: http://devicetree.org/schemas/mfd/nvidia-vrs-seq.yaml#
$schema: http://devicetree.org/meta-schemas/core.yaml#

title: NVIDIA VRS sequencer driver

maintainers:
  - Shubhi Garg <shgarg@nvidia.com>
  - Laxman Dewangan <ldewangan@nvidia.com>

description: |
  NVIDIA VRS sequencer device for controlling the voltage rails.

properties:
  compatible:
    const: "nvidia,vrs-pseq"

  reg:
    description:
      I2C device address.
    maxItems: 1

  interrupts:
    maxItems: 1

  interrupt-controller: true

  "#interrupt-cells":
    const: 2
    description:
      The first cell is the IRQ number, the second cell is the trigger type.

  rtc:
    $ref: ../rtc/nvidia-vrs-rtc.yaml



required:
  - compatible
  - reg
  - interrupts
  - interrupt-controller
  - "#interrupt-cells"

additionalProperties: false

examples:
  - |
    bpmp {
        i2c {
            vrs@3c {
                compatible = "nvidia,vrs-pseq";
                reg = <0x3c>;
                interrupt-parent = <&intc>;
                /* IRQ is active-low but pmc inverts the signal */
                interrupts = <GIC_SPI TEGRA234_IRQ_PMIC_EXT_INTR IRQ_TYPE_LEVEL_HIGH>;
                interrupt-controller;
                #interrupt-cells = <3>;

                vrs_rtc: rtc {
                        status = "okay";
                };
            };
        };
    };
```
